## arch/arm/mach-renesas/Kconfig
```kconfig
if ARCH_RENESAS

# Renesas ARM SoCs R-Car Gen3/Gen4 (64bit)
config RCAR_64
	bool
	select ARM64
	select CMD_CACHE
	select OF_BOARD_SETUP
	select PHY
	select PINCONF
	select PINCTRL
	select POSITION_INDEPENDENT
	imply CMD_FS_UUID
	imply CMD_GPT
	imply CMD_MMC_SWRITE if MMC
	imply CMD_UUID
	imply OF_UPSTREAM
	imply SUPPORT_EMMC_RPMB if MMC

config RCAR_GEN4
	bool "Renesas ARM SoCs R-Car Gen4 (64bit)"
	select RCAR_64
	select PINCTRL_PFC

config RZ_CMN
	bool "Renesas RZ/CMN Family ARM SoCs"
	select GICV3
	select RCAR_64
	select PINCTRL_PFC
	select SUPPORT_SPL
	imply CLK_RZG2L
	imply MULTI_DTB_FIT
	imply PINCTRL_RZG2L
	imply RENESAS_RAVB
	imply RENESAS_SDHI
	imply RZG2L_GPIO
	imply SCIF_CONSOLE
	imply SYS_I2C_RZ_RIIC
	imply SYS_MALLOC_F
	imply SPL
	imply SPL_BOARD_INIT
	imply SPL_LIBCOMMON_SUPPORT
	imply SPL_LIBGENERIC_SUPPORT
	imply SPL_SERIAL
	imply SPL_SYS_MALLOC_SIMPLE
	imply SPL_TINY_MEMSET
	imply SPL_USE_TINY_PRINTF
	help
		Enable support for boards based on Renesas RZ common SoCs.

		This currently includes platforms using RZ/G2L, RZ/V2L, and
		RZ/V2H

config SYS_SOC
	default "renesas" if ARCH_RENESAS

source "arch/arm/mach-renesas/Kconfig.32"
source "arch/arm/mach-renesas/Kconfig.64"
source "arch/arm/mach-renesas/Kconfig.rza1"
source "arch/arm/mach-renesas/Kconfig.rzn1"
source "arch/arm/mach-renesas/Kconfig.rzg2l"
source "arch/arm/mach-renesas/Kconfig.rzcmn"
source "arch/arm/mach-renesas/Kconfig.rcar4"

endif
```

## arch/arm/mach-renesas/Kconfig.rcar4
```kconfig
if RCAR_GEN4

menu "Select Target SoC"

config R8A779A0
	bool "Renesas SoC R8A779A0"
	default y if TARGET_FALCON
	select GICV3
	imply CLK_R8A779A0
	imply PINCTRL_PFC_R8A779A0

config R8A779F0
	bool "Renesas SoC R8A779F0"
	default y if TARGET_SPIDER || TARGET_S4SK
	select GICV3
	imply CLK_R8A779F0
	imply PINCTRL_PFC_R8A779F0

config R8A779G0
	bool "Renesas SoC R8A779G0"
	default y if TARGET_WHITEHAWK || TARGET_SPARROWHAWK
	select GICV3
	select BINMAN
	select SUPPORT_SPL
	imply SPL
	imply SPL_BOARD_INIT
	imply SPL_LIBCOMMON_SUPPORT
	imply SPL_LIBGENERIC_SUPPORT
	imply SPL_SERIAL
	imply SPL_SYS_MALLOC_SIMPLE
	imply SPL_TINY_MEMSET
	imply SPL_USE_TINY_PRINTF
	imply CLK_R8A779G0
	imply PINCTRL_PFC_R8A779G0

config R8A779H0
	bool "Renesas SoC R8A779H0"
	default y if TARGET_GRAYHAWK
	select GICV3
	imply CLK_R8A779H0
	imply PINCTRL_PFC_R8A779H0

endmenu

config TARGET_FALCON
	bool "Falcon board"
	help
          Support for Renesas R-Car Gen3 Falcon platform

config TARGET_SPIDER
	bool "Spider board"
	help
	  Support for Renesas R-Car Gen4 Spider platform

config TARGET_S4SK
	bool "S4SK board"
	help
	  Support for Renesas R-Car Gen4 S4SK platform

config TARGET_WHITEHAWK
	bool "White Hawk board"
	help
	  Support for Renesas R-Car Gen4 White Hawk platform

config TARGET_SPARROWHAWK
	bool "Sparrow Hawk board"
	help
	  Support for Renesas R-Car Gen4 Sparrow Hawk platform

config TARGET_GRAYHAWK
	bool "Gray Hawk board"
	help
	  Support for Renesas R-Car Gen4 Gray Hawk platform

source "board/renesas/falcon/Kconfig"
source "board/renesas/spider/Kconfig"
source "board/renesas/s4sk/Kconfig"
source "board/renesas/whitehawk/Kconfig"
source "board/renesas/sparrowhawk/Kconfig"
source "board/renesas/grayhawk/Kconfig"

endif
```

## arch/arm/mach-renesas/Kconfig.rzcmn
```kconfig
# Copyright (C) 2026 Renesas Electronics Corporation
# SPDX-License-Identifier: GPL-2.0+

if RZ_CMN

config R9A07Gx
	bool "Renesas CLK_RZ_CMN SoC"
	imply CLK_RZ_CMN
	help
		Enable support for the Renesas RZ common SoC family infrastructure.

		This option covers shared support used by multiple Renesas RZ
		platforms, including RZ/G2L, RZ/V2L, and RZ/V2H MPUs.

choice
	prompt "Renesas RZ/CMN selection"

config TARGET_RZ_CMN
	bool "Renesas Common"
	imply R9A07Gx
	help
		Select this target for platforms using the Renesas RZ common
		support layer.

		This currently includes MPUs such as RZ/G2L, RZ/V2L, and RZ/V2H.

endchoice

source "board/renesas/rz-cmn/Kconfig"

config MULTI_DTB_FIT_UNCOMPRESS_SZ
	default 0x80000 if TARGET_RZ_CMN

config MULTI_DTB_FIT_USER_DEF_ADDR
	default 0x49000000 if TARGET_RZ_CMN

endif
```

## arch/arm/mach-renesas/Kconfig.rzg2l
```kconfig
# Copyright (C) 2023 Renesas Electronics Corporation
# SPDX-License-Identifier: GPL-2.0+

if RZG2L

config R9A07G044L
	bool "Renesas R9A07G044L SoC"
	imply CLK_R9A07G044L
	help
	  Enable support for the Renesas R9A07G044L (RZ/G2L) SoC.

config R9A07Gx
	bool "Renesas SoC RZ Common Boards"

choice
	prompt "Renesas RZ/G2L Family Board selection"
	default TARGET_RZG2L_SMARC_EVK

config TARGET_RZG2L_SMARC_EVK
	bool "Renesas RZ/G2L SMARC EVK"
	imply R9A07G044L
	help
	  Enable support for the RZ/G2L SMARC evaluation board.

config TARGET_RZG2L_SBC
	bool "RZ/G2L SBC board"
	help
	  Support for Renesas RZG2L Raspberry-Pi-like board

config TARGET_RZ_CMN
	bool "RZ common boards"
	help
          Support for Renesas RZG2L SBC, SMARC RZV2L, SMARC RZG2L and RZV2H

endchoice

source "board/renesas/rzg2l/Kconfig"
source "board/renesas/rzg2l-sbc/Kconfig"
source "board/renesas/rz-cmn/Kconfig"

config MULTI_DTB_FIT_UNCOMPRESS_SZ
	default 0x80000 if TARGET_RZG2L_SMARC_EVK

config MULTI_DTB_FIT_USER_DEF_ADDR
	default 0x49000000 if TARGET_RZG2L_SMARC_EVK

endif
```

## board/renesas/rz-cmn/Kconfig
```kconfig
if TARGET_RZ_CMN

config SYS_SOC
	default "rmobile"

config SYS_BOARD
	default "rz-cmn"

config SYS_VENDOR
	default "renesas"

config SYS_CONFIG_NAME
	default "rz-cmn"

endif

if TARGET_SPARROWHAWK

config SYS_SOC
	default "renesas" if RCAR_GEN4

config SYS_BOARD
	default "rz-cmn"

config SYS_VENDOR
	default "renesas"

config SYS_CONFIG_NAME
	default "sparrowhawk"

endif
```

## board/renesas/rz-multi-boards/Kconfig
```kconfig
if TARGET_RZ_MULTI_BOARDS

config SYS_SOC
	default "rmobile"

config SYS_BOARD
	default "rz-multi-boards"

config SYS_VENDOR
	default "renesas"

config SYS_CONFIG_NAME
	default "rz-multi-boards"

endif
```

## board/renesas/rzg2l-sbc/Kconfig
```kconfig
if TARGET_RZG2L_SBC

config SYS_SOC
	default "rmobile"

config SYS_BOARD
	default "rzg2l-sbc"

config SYS_VENDOR
	default "renesas"

config SYS_CONFIG_NAME
	default "rzg2l-sbc"

endif
```

## configs/r8a779g3_sparrowhawk_defconfig
```kconfig
#include <configs/renesas_rcar4.config>
// CONFIG_BOARD_LATE_INIT=y
// CONFIG_LAST_STAGE_INIT=y
// CONFIG_SH_SDHI=y
//failed

CONFIG_ARCH_RENESAS=y
CONFIG_ARM=y
CONFIG_BITBANGMII=y
CONFIG_BOARD_EARLY_INIT_F=y
CONFIG_CLK_RZ_CMN=y
CONFIG_CMD_FASTBOOT=y
CONFIG_CMD_PCI=y
CONFIG_CMD_SF=y
CONFIG_CMD_USB=y
CONFIG_CMD_USB_MASS_STORAGE=y
CONFIG_DM_ETH=y
CONFIG_DM_MTD=y
CONFIG_DM_PCI=y
CONFIG_DM_USB=y
CONFIG_DWC_ETH_QOS=y
CONFIG_DWC_ETH_QOS_RZV2H=y
CONFIG_ENV_IS_IN_SPI_FLASH=y
// CONFIG_ENV_OFFSET=0x001E0000
CONFIG_ENV_OVERWRITE=y
// CONFIG_ENV_SECT_SIZE=0x20000
// CONFIG_ENV_SIZE=0x20000
CONFIG_FASTBOOT_BUF_ADDR=0x4D000000
CONFIG_FASTBOOT_BUF_SIZE=0x8000000
CONFIG_FASTBOOT_FLASH=y
CONFIG_FASTBOOT_FLASH_MMC_DEV=0
CONFIG_FASTBOOT_GPT_NAME="gpt"
CONFIG_FASTBOOT_MBR_NAME="mbr"
CONFIG_FASTBOOT_MMC_BOOT1_NAME="mmc0boot0"
CONFIG_FASTBOOT_MMC_BOOT2_NAME="mmc0boot1"
CONFIG_FASTBOOT_MMC_BOOT_SUPPORT=y
CONFIG_FASTBOOT_MMC_USER_NAME="mmc0"
CONFIG_FASTBOOT_MMC_USER_SUPPORT=y
CONFIG_FASTBOOT_USB_DEV=28
CONFIG_MULTI_DTB_FIT=y
CONFIG_NET_RANDOM_ETHADDR=y
CONFIG_OF_LIBFDT_OVERLAY=y
CONFIG_OF_PLATDATA=y
CONFIG_OF_UPSTREAM=y
CONFIG_OPTEE=y
CONFIG_PCI=y
CONFIG_PCI_RCAR_GEN3=y
CONFIG_PHY_MICREL=y
CONFIG_PHY_MICREL_KSZ90X1=y
CONFIG_PINCONF=y
CONFIG_PINCTRL_PFC=y
CONFIG_PINCTRL_PFC_RZG2L=y
CONFIG_R9A07Gx=y
CONFIG_RENESAS_RAVB=y
CONFIG_RESET_RZG2L_USBPHY_CTRL=y
CONFIG_RZ_CMN=y
CONFIG_SMBIOS_MANUFACTURER=""
CONFIG_SMBIOS_PRODUCT_NAME=""
CONFIG_SPI_FLASH=y
CONFIG_SPI_FLASH_ATMEL=y
CONFIG_SPI_FLASH_BAR=y
CONFIG_SPI_FLASH_ISSI=y
CONFIG_SPI_FLASH_MACRONIX=y
CONFIG_SPI_FLASH_STMICRO=y
CONFIG_SPI_FLASH_WINBOND=y
CONFIG_SPL=y
CONFIG_SPL_DM=y
CONFIG_SPL_GPIO=y
CONFIG_SPL_I2C=y
CONFIG_SPL_LIBCOMMON_SUPPORT=y
CONFIG_SPL_LIBGENERIC_SUPPORT=y
CONFIG_SPL_NO_BSS_LIMIT=y
CONFIG_SPL_TINY_MEMSET=y
CONFIG_SPL_USE_TINY_PRINTF=y
CONFIG_SYS_I2C_RCAR_IIC=y
CONFIG_SYS_I2C_RZG2L_RIIC=y
CONFIG_SYS_I2C_RZV2H_RIIC=y
CONFIG_SYS_MMC_ENV_DEV=0
CONFIG_SYS_MMC_ENV_PART=2
CONFIG_SYS_RELOC_GD_ENV_ADDR=y
CONFIG_TARGET_RZ_CMN=y
CONFIG_TEE=y
CONFIG_TEXT_BASE=0x50000000
CONFIG_UDP_FUNCTION_FASTBOOT=y
CONFIG_USB=y
CONFIG_USB_EHCI_GENERIC=y
CONFIG_USB_EHCI_HCD=y
CONFIG_USB_FUNCTION_FASTBOOT=y
CONFIG_USB_GADGET=y
CONFIG_USB_GADGET_MANUFACTURER="Renesas"
CONFIG_USB_GADGET_PRODUCT_NUM=0x4E23
CONFIG_USB_GADGET_VENDOR_NUM=0x18D1
CONFIG_USB_RENESAS_USBHS=y
CONFIG_USB_STORAGE=y
CONFIG_USB_XHCI_HCD=y
// # ================================================================ Sparrowhawk ================================================================
// CONFIG_OF_LIST="renesas/r8a779g3-sparrow-hawk"
CONFIG_OF_LIST="renesas/r8a779g3-sparrow-hawk renesas/smarc-rzv2l renesas/rzg2l-sbc renesas/smarc-rzg2l renesas/rzv2h-evk-ver1 renesas/rzv2h-rdk-ver1 renesas/imdt-v2h-sbc renesas/rs-g2l100"
// # failed - ko can dung
# CONFIG_SPL_BOARD_INIT is not set
# CONFIG_SPL_DM_MMC is not set
# CONFIG_SPL_DOS_PARTITION is not set
# CONFIG_SPL_EFI_PARTITION is not set
# CONFIG_SPL_LEGACY_IMAGE_FORMAT is not set
# CONFIG_SPL_PARTITIONS is not set
# CONFIG_SPL_PARTITION_UUIDS is not set
# CONFIG_SPL_SEPARATE_BSS is not set
# CONFIG_SPL_SHARES_INIT_SP_ADDR is not set
# CONFIG_USB_XHCI_RCAR is not set
CONFIG_ARMV8_PSCI=y
CONFIG_ARM_SMCCC=y
CONFIG_BAUDRATE=115200
CONFIG_BINMAN=y
CONFIG_BOOTARGS="rw root=/dev/nfs nfsroot=169.254.43.7:/tftpboot/sonnguyen/v4h_sparrow/nfs_cmn,v3,tcp ip=169.254.43.9:::::eth0"
CONFIG_BOOTCOMMAND="tftp 0x48080000 sonnguyen/v4h_sparrow/boot/Image; tftp 0x48000000 sonnguyen/v4h_sparrow/boot/r8a779g3-sparrow-hawk.dtb; booti 0x48080000 - 0x48000000"
CONFIG_CMD_NFS=y
CONFIG_CMD_REMOTEPROC=y
CONFIG_DEFAULT_DEVICE_TREE="renesas/r8a779g3-sparrow-hawk"
CONFIG_DEFAULT_FDT_FILE="r8a779g3-sparrow-hawk.dtb"
CONFIG_ENABLE_ARM_SOC_BOOT0_HOOK=y
CONFIG_ENV_OFFSET=0x3f80000
CONFIG_ENV_OFFSET_REDUND=0x3fc0000
CONFIG_ENV_REDUNDANT=y
CONFIG_ENV_SECT_SIZE=0x40000
CONFIG_ENV_SIZE=0x40000
CONFIG_ENV_SOURCE_FILE="sparrowhawk"
CONFIG_GPIO_HOG=y
CONFIG_NVME_PCI=y
CONFIG_PCI_RCAR_GEN4=y
CONFIG_PCI_REGION_MULTI_ENTRY=y
CONFIG_RAM=y
CONFIG_RAM_RENESAS_DBSC5=y
CONFIG_RCAR_GEN4=y
CONFIG_REMOTEPROC_RENESAS_APMU=y
CONFIG_SF_DEFAULT_SPEED=40000000
CONFIG_SPL_BSS_MAX_SIZE=0x10000
CONFIG_SPL_CLK=y
CONFIG_SPL_DM_RESET=y
CONFIG_SPL_DM_SPI=y
CONFIG_SPL_DM_SPI_FLASH=y
CONFIG_SPL_FIT_PRINT=y
CONFIG_SPL_GPIO_HOG=y
CONFIG_SPL_HAS_LOAD_FIT_ADDRESS=y
CONFIG_SPL_HAVE_INIT_STACK=y
CONFIG_SPL_LOAD_FIT=y
CONFIG_SPL_LOAD_FIT_ADDRESS=0x48000000
CONFIG_BOARD_SIZE_LIMIT=2097152
CONFIG_SPL_MAX_SIZE=0x80000
CONFIG_SPL_OF_CONTROL=y
CONFIG_SPL_PINCONF=y
CONFIG_SPL_PINCTRL=y
CONFIG_SPL_RAM=y
CONFIG_SPL_SPI=y
CONFIG_SPL_SPI_FLASH_SUPPORT=y
CONFIG_SPL_SPI_LOAD=y
CONFIG_SPL_STACK=0xe6400000
CONFIG_SPL_STACK_R=y
CONFIG_SPL_STACK_R_ADDR=0x44000000
CONFIG_SPL_STACK_R_MALLOC_SIMPLE_LEN=0x400000
CONFIG_SPL_SYS_MALLOC_F_LEN=0x20000
CONFIG_SPL_TEXT_BASE=0xeb210000
CONFIG_SYS_BARGSIZE=2048
CONFIG_SYS_BOOT_GET_CMDLINE=y
CONFIG_SYS_CBSIZE=2048
CONFIG_SYS_CLK_FREQ=16666666
CONFIG_SYS_SPI_U_BOOT_OFFS=0x80000
CONFIG_TARGET_SPARROWHAWK=y
CONFIG_USB_XHCI_GENERIC=y
CONFIG_USB_XHCI_PCI=y
CONFIG_USE_BOOTARGS=y
CONFIG_USE_PREBOOT=y
```
